&sde_dsi {
	/delete-property/ qcom,dsi-default-panel;
	qcom,dsi-default-panel = <&dsi_oplus20031_samsung_1440_3216_dsc_cmd_dvt_id07>;
};
&sde_dsi1 {
	/delete-property/ qcom,dsi-default-panel;
	qcom,dsi-default-panel = <&dsi_oplus_20085_boe_nt37800_1080_2400_cmd>;
};